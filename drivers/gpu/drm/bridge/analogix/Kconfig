## drivers/gpu/drm/bridge/analogix/Kconfig
```kconfig
# SPDX-License-Identifier: GPL-2.0-only
config DRM_ANALOGIX_DP
	tristate
	depends on DRM

config DRM_ANALOGIX_ANX7625
	tristate "Analogix Anx7625 MIPI to DP interface support"
	depends on DRM
	depends on OF
	help
	  ANX7625 is an ultra-low power 4K mobile HD transmitter
	  designed for portable devices. It converts MIPI/DPI to
	  DisplayPort1.3 4K.
```

## drivers/platform/msm/mhi_ssr/Kconfig
```kconfig
# SPDX-License-Identifier: GPL-2.0-only
# Copyright (c) 2018-2021, The Linux Foundation. All rights reserved.

menu "MHI_SSR"

config QTI_MHI_SSR
       tristate "MHI SSR"
       depends on MHI_QCOM
       help
	If you say yes to this option,
	MHI SSR support via sysfs for
	Qualcomm Technologies, Inc chipsets
	will be enabled, in case esoc support
	is not present.
endmenu
```

## techpack/Kconfig
```kconfig
menu "Techpack Drivers"

source "techpack/datarmnet-ext/offload/Kconfig"

source "techpack/datarmnet-ext/shs/Kconfig"

source "techpack/datarmnet/core/Kconfig"

source "techpack/oneplus/power/oplus_chg/Kconfig"

endmenu
```
